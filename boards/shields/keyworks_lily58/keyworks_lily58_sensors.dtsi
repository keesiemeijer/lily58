/*
 * Copyright (c) 2022 The ZMK Contributors
 *
 * SPDX-License-Identifier: MIT
 */

/ {
    left_encoder: left_encoder {
        compatible = "alps,ec11";
        steps = <80>;
        status = "disabled";

        a-gpios = <&pro_micro 7 GPIO_PULL_UP>;
        b-gpios = <&pro_micro 6 GPIO_PULL_UP>;
    };

    right_encoder: right_encoder {
        compatible = "alps,ec11";
        steps = <80>;
        status = "disabled";

        a-gpios = <&pro_micro 14 GPIO_PULL_UP>;
        b-gpios = <&pro_micro 15 GPIO_PULL_UP>;
    };

    sensors: sensors {
        compatible = "zmk,keymap-sensors";
        sensors = <&left_encoder &right_encoder>;
        triggers-per-rotation = <20>;
    };
};
