## boards/shields/keyworks_lily58/Kconfig.defconfig
```kconfig
# Copyright (c) 2022 The ZMK Contributors
# SPDX-License-Identifier: MIT

if SHIELD_KEYWORKS_LILY58_LEFT

# Name must be less than 16 characters long!
config ZMK_KEYBOARD_NAME
    default "KeyWorks Lily58"

config ZMK_SPLIT_ROLE_CENTRAL
    default y
endif

if SHIELD_KEYWORKS_LILY58_LEFT || SHIELD_KEYWORKS_LILY58_RIGHT

config ZMK_SPLIT
    default y

config ZMK_DISPLAY

if ZMK_DISPLAY

config SSD1306
    default y

config I2C
    default y

endif # ZMK_DISPLAY

if LVGL

config LV_Z_VDB_SIZE
    default 64

config LV_DPI_DEF
    default 148

config LV_Z_BITS_PER_PIXEL
    default 1

choice LV_COLOR_DEPTH
    default LV_COLOR_DEPTH_1
endchoice

endif # LVGL

endif # SHIELD_KEYWORKS_LILY58_LEFT || SHIELD_KEYWORKS_LILY58_RIGHT
```

## boards/shields/keyworks_lily58/Kconfig.shield
```kconfig
# Copyright (c) 2022 The ZMK Contributors
# SPDX-License-Identifier: MIT

# No whitespace after the comma or in your part name!
config SHIELD_KEYWORKS_LILY58_LEFT
    def_bool $(shields_list_contains,keyworks_lily58_left)

# No whitespace after the comma or in your part name!
config SHIELD_KEYWORKS_LILY58_RIGHT
    def_bool $(shields_list_contains,keyworks_lily58_right)
```

## boards/shields/lily_practice/Kconfig.shield
```kconfig
# Copyright (c) 2022 The ZMK Contributors
# SPDX-License-Identifier: MIT

# No whitespace after the comma or in your part name!
config SHIELD_LILY58_LEFT
    def_bool $(shields_list_contains,lily58_left)

# No whitespace after the comma or in your part name!
config SHIELD_LILY58_RIGHT
    def_bool $(shields_list_contains,lily58_right)
```
